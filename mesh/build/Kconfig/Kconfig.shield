## mesh/build/Kconfig/Kconfig.shield
```kconfig
osource "d:/bluemesh/tflite/tflite-v2/mesh/boards/shields/*/Kconfig.shield"
osource "d:/bluemesh/tflite/tflite-v2/mesh_1/boards/shields/*/Kconfig.shield"
osource "d:/bluemesh/mesh/boards/shields/*/Kconfig.shield"
osource "d:/bluemesh/tflite/tflite-mesh/mesh/boards/shields/*/Kconfig.shield"
osource "D:/ncs/v2.4.2/v2.4.2/nrf/boards/shields/*/Kconfig.shield"
```

## mesh_1DCNN/build_1/Kconfig/Kconfig.shield
```kconfig
osource "d:/bluemesh/tflite/tflite-v2/mesh_1dcnn/boards/shields/*/Kconfig.shield"
osource "d:/bluemesh/tflite/tflite-v2/mesh_1/boards/shields/*/Kconfig.shield"
osource "d:/bluemesh/mesh/boards/shields/*/Kconfig.shield"
osource "d:/bluemesh/tflite/tflite-v2/mesh_2.4.2/boards/shields/*/Kconfig.shield"
osource "D:/ncs/v2.4.2/v2.4.2/nrf/boards/shields/*/Kconfig.shield"
```

## mesh_provisioner/build/Kconfig/Kconfig.shield.defconfig
```kconfig
osource "d:/bluemesh/tflite/tflite-v2/mesh_1dcnn/boards/shields/*/Kconfig.defconfig"
osource "d:/bluemesh/tflite/tflite-v2/mesh_1/boards/shields/*/Kconfig.defconfig"
osource "d:/bluemesh/mesh/boards/shields/*/Kconfig.defconfig"
osource "D:/ncs/v2.4.2/v2.4.2/nrf/boards/shields/*/Kconfig.defconfig"
```
